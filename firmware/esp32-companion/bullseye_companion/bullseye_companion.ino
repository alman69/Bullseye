// Bullseye Companion: ONE FILE for ESP32-S3 display + scooper over ONE BLE connection.
// Generated by firmware/esp32-companion/generate.py. No repository headers needed to upload.
// Core 3.3.12 / 32MB OPI flash / OPI PSRAM / Default 4MB with spiffs / CDC disabled.
// Existing DFRobot_GDL, Adafruit GFX and BusIO libraries remain required.
// Servos: GPIO39/40, separate 5V supply sharing GND; both command 90 degrees on boot.


// ===== esp32-display/bullseye_display/PixelFace.h =====

#include <stdint.h>
#include <string.h>

namespace bullseye {
constexpr uint16_t kNavy = 0x0884, kCream = 0xef3a, kSteel = 0x326c, kRed = 0xe1c5;
constexpr uint8_t kDistancePage = 0, kLinkPage = 1, kFacePage = 2, kPageCount = 3;
enum class Mood : uint8_t { Idle, Happy, Curious, Grumpy, Sleepy };
inline const char* moodName(Mood mood) {
  switch (mood) {
    case Mood::Happy: return "HAPPY";
    case Mood::Curious: return "CURIOUS";
    case Mood::Grumpy: return "GRUMPY";
    case Mood::Sleepy: return "SLEEPY";
    default: return "IDLE";
  }
}

// Local animation only: no sensor thresholds, BLE fields or rover commands.
class FaceController {
 public:
  Mood mood(uint32_t now) const {
    const uint32_t steps = automatic_ ? static_cast<uint32_t>(now - changedAt_) / 4000 : 0;
    return static_cast<Mood>((static_cast<uint8_t>(selected_) + steps) % 5);
  }
  uint32_t elapsed(uint32_t now) const {
    const uint32_t age = now - changedAt_;
    return automatic_ ? age % 4000 : age;
  }
  bool automatic() const { return automatic_; }
  void select(Mood mood, uint32_t now) { selected_ = mood; automatic_ = false; changedAt_ = now; }
  void next(uint32_t now) {
    selected_ = static_cast<Mood>((static_cast<uint8_t>(mood(now)) + 1) % 5);
    automatic_ = false; changedAt_ = now;
  }
  void toggleAuto(uint32_t now) {
    selected_ = mood(now); automatic_ = !automatic_; changedAt_ = now;
  }
 private:
  Mood selected_ = Mood::Happy;
  bool automatic_ = true;
  uint32_t changedAt_ = 0;
};

enum class Ink : uint8_t { Navy, Cream, Steel, Red };
// Eight-pixel cells enlarge the approved artwork across the entire LCD. Two tiny buffers replace
// a full-screen framebuffer; only changed horizontal runs reach the SPI display.
struct FaceFrame {
  static constexpr int columns = 60, rows = 40, cell = 8, x = 0, y = 0;
  uint8_t cells[columns * rows] = {};
  void rect(int left, int top, int width, int height, Ink ink = Ink::Cream) {
    left += 5; top += 5;  // Center the original face geometry in 480x320.
    for (int row = top; row < top + height; ++row) {
      if (row < 0 || row >= rows) continue;
      for (int col = left; col < left + width; ++col) {
        if (col >= 0 && col < columns) cells[row * columns + col] = static_cast<uint8_t>(ink);
      }
    }
  }
};

inline FaceFrame pixelFace(Mood mood, uint32_t elapsed) {
  FaceFrame frame;
  const bool blink = elapsed % 3800 >= 3500 && elapsed % 3800 < 3700;
  const int bob = mood == Mood::Happy && elapsed % 800 >= 400 ? 1 : 0;
  const int glance = mood == Mood::Curious ? static_cast<int>((elapsed / 600) % 4) - 1 : 0;
  const int gaze = glance > 1 ? 0 : glance;
  const int twitch = mood == Mood::Grumpy && elapsed % 2200 >= 1900 ? 1 : 0;
  const int breath = mood == Mood::Sleepy && elapsed % 1600 >= 800 ? 1 : 0;
  for (int index = 0; index < 2; ++index) {
    const int center = index == 0 ? 12 : 37;
    if (mood == Mood::Happy) {
      frame.rect(center - 5, 4 + bob, 3, 1);
      frame.rect(center - 2, 3 + bob, 5, 1);
      frame.rect(center + 3, 4 + bob, 3, 1);
      if (blink) frame.rect(center - 4, 13 + bob, 9, 1);
      else {
        frame.rect(center - 5, 11 + bob, 2, 4);
        frame.rect(center - 3, 10 + bob, 2, 2);
        frame.rect(center - 1, 9 + bob, 3, 2);
        frame.rect(center + 2, 10 + bob, 2, 2);
        frame.rect(center + 4, 11 + bob, 2, 4);
      }
    } else if (mood == Mood::Sleepy) {
      frame.rect(center - 4, 8, 9, 1, Ink::Steel);
      frame.rect(center - 5, 13 + breath, 3, 1);
      frame.rect(center - 2, 14 + breath, 5, 1);
      frame.rect(center + 3, 13 + breath, 3, 1);
    } else {
      if (mood == Mood::Grumpy) {
        frame.rect(center - 5, (index == 0 ? 4 : 7) + twitch, 5, 2, Ink::Red);
        frame.rect(center, (index == 0 ? 7 : 4) + twitch, 6, 2, Ink::Red);
        if (blink) frame.rect(center - 4, 13, 9, 1);
        else {
          frame.rect(center - 4, 11, 9, 6);
          for (int row = 0; row < 3; ++row) {
            const int cut = 6 - row * 2;
            frame.rect(center - 4 + (index == 0 ? 0 : cut), 8 + row, 9 - cut, 1);
          }
        }
      } else {
        if (mood == Mood::Curious) {
          const int raise = index == 0 && elapsed % 1600 >= 800 ? 1 : 0;
          frame.rect(center - 5, (index == 0 ? 3 : 6) - raise, 5, 1);
          frame.rect(center, (index == 0 ? 2 : 6) - raise, 6, 1);
        } else frame.rect(center - 4, 4, 9, 1, Ink::Steel);
        if (blink) frame.rect(center - 4 + gaze, 13, 9, 1);
        else frame.rect(center - 4 + gaze, mood == Mood::Curious && index == 1 ? 10 : 7,
                        9, mood == Mood::Curious ? (index == 0 ? 13 : 9) : 11);
      }
    }
  }
  if (mood == Mood::Happy) {
    frame.rect(19, 20 + bob, 2, 4); frame.rect(21, 23 + bob, 2, 2);
    frame.rect(23, 25 + bob, 6, 2); frame.rect(29, 23 + bob, 2, 2); frame.rect(31, 20 + bob, 2, 4);
    frame.rect(3, 17 + bob, 3, 1, Ink::Red); frame.rect(46, 17 + bob, 3, 1, Ink::Red);
  } else if (mood == Mood::Grumpy) {
    frame.rect(21, 25, 2, 2); frame.rect(23, 24, 2, 1); frame.rect(25, 23, 4, 1);
    frame.rect(29, 24, 2, 1); frame.rect(31, 25, 2, 2);
    const int pulse = (elapsed / 300) % 2;
    frame.rect(50, 5 + pulse, 1, 3, Ink::Red); frame.rect(52, 8 + pulse, 3, 1, Ink::Red);
  } else if (mood == Mood::Sleepy) {
    frame.rect(24, 22, 4, 1); frame.rect(24, 25 + breath, 4, 1);
    frame.rect(24, 23, 1, 2 + breath); frame.rect(27, 23, 1, 2 + breath);
    const int drift = (elapsed / 500) % 3;
    frame.rect(46, 3 - drift, 4, 1, Ink::Red); frame.rect(48, 4 - drift, 1, 1, Ink::Red);
    frame.rect(47, 5 - drift, 1, 1, Ink::Red); frame.rect(46, 6 - drift, 4, 1, Ink::Red);
  } else if (mood == Mood::Curious) {
    frame.rect(23, 23, 5, 1); frame.rect(28, 22, 1, 2); frame.rect(29, 22, 3, 1);
  } else {
    frame.rect(22, 22, 1, 1); frame.rect(22, 23, 8, 1); frame.rect(29, 22, 1, 1);
  }
  return frame;
}

class FaceRenderer {
 public:
  void invalidate() { valid_ = false; }
  template <class Screen> void render(Screen& screen, const FaceController& controller, uint32_t now) {
    const FaceFrame next = pixelFace(controller.mood(now), controller.elapsed(now));
    constexpr uint16_t palette[] = {kNavy, kCream, kSteel, kRed};
    for (int row = 0; row < FaceFrame::rows; ++row) {
      int col = 0;
      while (col < FaceFrame::columns) {
        const int index = row * FaceFrame::columns + col;
        const auto ink = next.cells[index];
        if ((valid_ && ink == previous_.cells[index]) || (!valid_ && ink == 0)) { ++col; continue; }
        const int start = col++;
        while (col < FaceFrame::columns && next.cells[row * FaceFrame::columns + col] == ink &&
               (!valid_ || previous_.cells[row * FaceFrame::columns + col] != ink)) ++col;
        screen.fillRect(FaceFrame::x + start * FaceFrame::cell, FaceFrame::y + row * FaceFrame::cell,
                        (col - start) * FaceFrame::cell, FaceFrame::cell, palette[ink]);
      }
    }
    previous_ = next; valid_ = true;
  }
 private:
  FaceFrame previous_;
  bool valid_ = false;
};
}  // namespace bullseye


// ===== esp32-display/bullseye_display/DisplayProtocol.h =====

#include <stdint.h>
#include <stddef.h>
#include <stdio.h>
#include <string.h>
#include <limits.h>

namespace bullseye {
constexpr char kServiceUuid[] = "3f7c1000-6f54-4a9c-8b2d-56e39a18c201";
constexpr char kRxUuid[] = "3f7c1001-6f54-4a9c-8b2d-56e39a18c201";
constexpr char kAckUuid[] = "3f7c1002-6f54-4a9c-8b2d-56e39a18c201";
constexpr size_t kMaxFrame = 256;  // Includes newline; storage ends with NUL instead.
constexpr uint32_t kPartialTimeoutMs = 2000, kSampleStaleMs = 1500, kDataTimeoutMs = 3000;
enum class Ack : uint8_t { Applied = 0, Invalid = 1, Overflow = 2, Old = 3 };
enum class Status : uint8_t { Live, Stale, Invalid, Unavailable };
enum class Expression : uint8_t { Auto, Happy };
enum class Source : uint8_t { Rover, Demo };

inline void encodeAck(uint8_t out[8], Ack status, uint32_t seq) {
  out[0] = 'B'; out[1] = 'S'; out[2] = 1; out[3] = static_cast<uint8_t>(status);
  for (uint8_t i = 0; i < 4; ++i) out[4 + i] = static_cast<uint8_t>(seq >> (8 * i));
}

struct Frame {
  char text[kMaxFrame] = {};
  uint16_t length = 0;
  uint32_t epoch = 0, startedMs = 0;
};

// External synchronization is provided by the Arduino adapter. No heap allocation
// or JSON parsing occurs here; the BLE callback only frames and queues bytes.
class Receiver {
 public:
  void reset() { length_ = count_ = head_ = 0; dropping_ = false; error_ = 0; }
  void expire(uint32_t now) {
    if (length_ && static_cast<uint32_t>(now - started_) >= kPartialTimeoutMs) {
      length_ = 0; dropping_ = true; error_ = static_cast<uint8_t>(Ack::Invalid);
    }
  }
  void feed(const uint8_t* bytes, size_t size, uint32_t now, uint32_t epoch) {
    expire(now);
    for (size_t i = 0; i < size; ++i) {
      const uint8_t c = bytes[i];
      if (dropping_) { if (c == '\n') dropping_ = false; continue; }
      if (c == '\n') {
        if (length_ == 0) { error_ = static_cast<uint8_t>(Ack::Invalid); continue; }
        if (count_ == 2) error_ = static_cast<uint8_t>(Ack::Overflow);
        else {
          Frame& frame = queue_[(head_ + count_) % 2];
          memcpy(frame.text, buffer_, length_);
          frame.text[length_] = '\0';
          frame.length = length_; frame.epoch = epoch; frame.startedMs = started_;
          ++count_;
        }
        length_ = 0;
      } else if (length_ == kMaxFrame - 1) {
        length_ = 0; dropping_ = true; error_ = static_cast<uint8_t>(Ack::Overflow);
      } else {
        if (length_ == 0) started_ = now;
        buffer_[length_++] = static_cast<char>(c);
      }
    }
  }
  bool pop(Frame& frame) {
    if (!count_) return false;
    frame = queue_[head_]; head_ = (head_ + 1) % 2; --count_; return true;
  }
  uint8_t takeError() { const uint8_t error = error_; error_ = 0; return error; }
  void reject() { error_ = static_cast<uint8_t>(Ack::Invalid); }
 private:
  Frame queue_[2];
  char buffer_[kMaxFrame] = {};
  uint16_t length_ = 0;
  uint8_t count_ = 0, head_ = 0, error_ = 0;
  bool dropping_ = false;
  uint32_t started_ = 0;
};

struct Sample {
  uint32_t seq = 0, ageMs = 0;
  uint16_t cm = 0;
  bool hasDistance = false, hasAge = false, roverConnected = false;
  Status status = Status::Unavailable;
  Source source = Source::Rover;
  Expression expression = Expression::Auto;
};

enum class ViewState : uint8_t { Disconnected, Waiting, Timeout, Unavailable, Invalid, Stale, Live };
class Model {
 public:
  void link(bool connected, uint32_t epoch, uint32_t now = 0) {
    if (connected_ != connected || epoch_ != epoch) {
      connected_ = connected; epoch_ = epoch; hasSample_ = false; sample_ = Sample();
      linked_ = now;
    }
  }
  Ack apply(const Sample& sample, const Frame& frame, uint32_t now) {
    if (!sample.seq) return Ack::Invalid;
    if (!connected_ || frame.epoch != epoch_) return Ack::Old;
    if (hasSample_ && sample.seq <= sample_.seq) return Ack::Old;
    if (sample.expression == Expression::Happy && !happyActive(now)) happyAt_ = now;
    sample_ = sample; hasSample_ = true; started_ = frame.startedMs; applied_ = now;
    return Ack::Applied;
  }
  uint32_t age(uint32_t now) const {
    const uint64_t value = static_cast<uint64_t>(sample_.ageMs) + static_cast<uint32_t>(now - started_);
    return value > UINT32_MAX ? UINT32_MAX : static_cast<uint32_t>(value);
  }
  ViewState state(uint32_t now) const {
    if (!connected_) return ViewState::Disconnected;
    if (!hasSample_) return static_cast<uint32_t>(now - linked_) >= kDataTimeoutMs ? ViewState::Timeout : ViewState::Waiting;
    if (static_cast<uint32_t>(now - applied_) >= kDataTimeoutMs) return ViewState::Timeout;
    if (sample_.status == Status::Invalid) return ViewState::Invalid;
    if (sample_.status == Status::Unavailable || (sample_.source == Source::Rover && !sample_.roverConnected)) return ViewState::Unavailable;
    if (sample_.status == Status::Stale || !sample_.hasAge || age(now) >= kSampleStaleMs) return ViewState::Stale;
    return sample_.hasDistance ? ViewState::Live : ViewState::Unavailable;
  }
  bool happyActive(uint32_t now) const {
    return connected_ && hasSample_ && sample_.roverConnected && sample_.source == Source::Rover &&
           sample_.expression == Expression::Happy && static_cast<uint32_t>(now - applied_) < kDataTimeoutMs;
  }
  uint8_t displayPage(uint32_t now) const { return happyActive(now) ? kFacePage : page; }
  FaceController displayFace(uint32_t now) const {
    FaceController result = face;
    if (happyActive(now)) result.select(Mood::Happy, happyAt_);
    return result;
  }
  const Sample& sample() const { return sample_; }
  bool connected() const { return connected_; }
  bool hasSample() const { return hasSample_; }
  uint32_t errors = 0;
  uint8_t page = kFacePage;
  FaceController face;
 private:
  Sample sample_;
  uint32_t epoch_ = 0, started_ = 0, applied_ = 0, linked_ = 0, happyAt_ = 0;
  bool connected_ = false, hasSample_ = false;
};

inline const char* stateLabel(ViewState state) {
  switch (state) {
    case ViewState::Disconnected: return "BLE disconnected";
    case ViewState::Waiting: return "Waiting for data";
    case ViewState::Timeout: return "Application timed out";
    case ViewState::Unavailable: return "Rover unavailable";
    case ViewState::Invalid: return "No echo / invalid";
    case ViewState::Stale: return "Stale reading";
    default: return "Live distance";
  }
}
struct DisplayText {
  char lines[9][80] = {};
};
inline DisplayText present(const Model& model, const char* touch, uint32_t now) {
  DisplayText text;
  const Sample& sample = model.sample();
  const ViewState state = model.state(now);
  snprintf(text.lines[0], 80, "%s", model.hasSample() && sample.source == Source::Demo ? "DEMO DATA" : "FIELD TELEMETRY");
  if (state == ViewState::Live) snprintf(text.lines[1], 80, "%u%s cm", sample.cm, sample.cm == 150 ? "+" : "");
  else snprintf(text.lines[1], 80, "-- cm");
  snprintf(text.lines[2], 80, "%s", stateLabel(state));
  if (model.hasSample() && sample.hasAge) snprintf(text.lines[3], 80, "Sample age: %lu.%lu s | UNCALIBRATED", static_cast<unsigned long>(model.age(now) / 1000), static_cast<unsigned long>((model.age(now) % 1000) / 100));
  else snprintf(text.lines[3], 80, "Sample age: unknown | UNCALIBRATED");
  snprintf(text.lines[4], 80, "%s", model.connected() ? "Connected" : "Disconnected");
  const bool current = state != ViewState::Disconnected && state != ViewState::Waiting && state != ViewState::Timeout;
  snprintf(text.lines[5], 80, "%s", !current ? "Unknown" : sample.source == Source::Demo ? "Demo (no rover)" : sample.roverConnected ? "Connected" : "Disconnected");
  snprintf(text.lines[6], 80, "%lu", static_cast<unsigned long>(model.hasSample() ? sample.seq : 0));
  snprintf(text.lines[7], 80, "%s", touch);
  snprintf(text.lines[8], 80, "%lu", static_cast<unsigned long>(model.errors));
  return text;
}
}  // namespace bullseye


// ===== esp32-display/bullseye_display/DisplayJson.h =====

#include <math.h>
#include <string.h>
#include <cJSON.h>

namespace bullseye {
inline bool jsonUint(const cJSON* item, uint32_t& value, uint32_t min = 0) {
  if (!cJSON_IsNumber(item) || !isfinite(item->valuedouble) || item->valuedouble < min ||
      item->valuedouble > UINT32_MAX || floor(item->valuedouble) != item->valuedouble) return false;
  value = static_cast<uint32_t>(item->valuedouble); return true;
}
inline bool decodeSample(const Frame& frame, Sample& sample) {
  if (!frame.length || frame.length >= kMaxFrame || frame.text[frame.length] != '\0' ||
      memchr(frame.text, '\0', frame.length) || strstr(frame.text, "\\u0000")) return false;
  const char* end = nullptr;
  cJSON* root = cJSON_ParseWithLengthOpts(frame.text, frame.length + 1, &end, true);
  if (!root) return false;
  bool valid = cJSON_IsObject(root) && end == frame.text + frame.length;
  constexpr const char* names[] = {"v", "seq", "distance_cm", "status", "sample_age_ms", "rover_connected", "source", "expression"};
  unsigned fields = 0;
  for (const cJSON* child = root->child; child && valid; child = child->next) {
    unsigned index = 0;
    for (; index < 8 && strcmp(child->string ? child->string : "", names[index]); ++index) {}
    if (index == 8 || fields & (1u << index)) valid = false;
    else fields |= 1u << index;
  }
  valid = valid && (fields == 127 || fields == 255);
  if (valid) {
    const auto field = [root](const char* name) { return cJSON_GetObjectItemCaseSensitive(root, name); };
    uint32_t version = 0, distance = 0;
    const cJSON* cm = field("distance_cm");
    const cJSON* age = field("sample_age_ms");
    const cJSON* status = field("status");
    const cJSON* source = field("source");
    const cJSON* expression = field("expression");
    sample.expression = Expression::Auto;
    valid = jsonUint(field("v"), version) && version == 1 && jsonUint(field("seq"), sample.seq, 1) &&
            cJSON_IsBool(field("rover_connected")) && cJSON_IsString(status) && cJSON_IsString(source);
    sample.roverConnected = cJSON_IsTrue(field("rover_connected"));
    sample.hasDistance = !cJSON_IsNull(cm);
    sample.hasAge = !cJSON_IsNull(age);
    valid = valid && (!sample.hasDistance || (jsonUint(cm, distance, 1) && distance <= 150)) &&
            (!sample.hasAge || jsonUint(age, sample.ageMs));
    sample.cm = static_cast<uint16_t>(distance);
    if (valid) {
      if (expression) {
        if (!cJSON_IsString(expression)) valid = false;
        else if (!strcmp(expression->valuestring, "happy")) sample.expression = Expression::Happy;
        else if (strcmp(expression->valuestring, "auto")) valid = false;
      }
      if (!strcmp(status->valuestring, "live")) sample.status = Status::Live;
      else if (!strcmp(status->valuestring, "stale")) sample.status = Status::Stale;
      else if (!strcmp(status->valuestring, "invalid")) sample.status = Status::Invalid;
      else if (!strcmp(status->valuestring, "unavailable")) sample.status = Status::Unavailable;
      else valid = false;
      if (!strcmp(source->valuestring, "rover")) sample.source = Source::Rover;
      else if (!strcmp(source->valuestring, "demo")) sample.source = Source::Demo;
      else valid = false;
      if (sample.status == Status::Live && (!sample.hasDistance || !sample.hasAge)) valid = false;
      if ((sample.status == Status::Invalid || sample.status == Status::Unavailable) && sample.hasDistance) valid = false;
    }
  }
  cJSON_Delete(root);
  return valid;
}
}  // namespace bullseye


// ===== esp32-display/bullseye_display/DisplayRenderer.h =====


namespace bullseye {
class Renderer {
 public:
  template <class Screen> void render(Screen& screen, const Model& model, const char* touch, uint32_t now) {
    const uint8_t page = model.displayPage(now);
    const bool layout = !painted_ || page_ != page;
    if (layout) {
      screen.fillScreen(kNavy); screen.setTextWrap(false);
      faceRenderer_.invalidate();
    }
    if (page == kFacePage) {
      faceRenderer_.render(screen, model.displayFace(now), now);
      page_ = page; painted_ = true;
      return;  // Full-screen face: no title, labels, status, buttons or tabs.
    }
    const DisplayText text = present(model, touch, now);
    if (layout) {
      print(screen, 12, 12, 2, "BULLSEYE", kCream);
      screen.fillRect(12, 43, 456, 2, kRed);
      if (page == kDistancePage) print(screen, 16, 65, 1, "ULTRASONIC DISTANCE", kCream);
      else if (page == kLinkPage) {
        const char* labels[] = {"Bluetooth", "Rover", "Source", "Freshness", "Last sequence", "Touch controller", "Protocol errors"};
        for (uint8_t i = 0; i < 7; ++i) print(screen, 16, 63 + i * 29, 1, labels[i], kCream);
      }
    }
    if (layout || strcmp(previous_.lines[0], text.lines[0])) field(screen, 275, 17, 194, 15, 1, text.lines[0], kCream);
    if (page == kDistancePage) {
      if (layout || strcmp(previous_.lines[1], text.lines[1])) field(screen, 16, 103, 450, 65, 6, text.lines[1], kCream);
      if (layout || strcmp(previous_.lines[2], text.lines[2])) field(screen, 16, 192, 450, 24, 2, text.lines[2], model.state(now) == ViewState::Live ? kCream : kRed);
      if (layout || strcmp(previous_.lines[3], text.lines[3])) field(screen, 16, 229, 450, 14, 1, text.lines[3], kCream);
      if (layout || strcmp(previous_.lines[4], text.lines[4]) || strcmp(previous_.lines[5], text.lines[5])) {
        char line[80]; snprintf(line, sizeof(line), "BLE: %.20s | ROVER: %.20s", text.lines[4], text.lines[5]);
        field(screen, 16, 251, 450, 12, 1, line, kCream);
      }
    } else {
      const uint8_t rows[] = {4, 5, 0, 2, 6, 7, 8};
      for (uint8_t row = 0; row < 7; ++row) {
        const uint8_t index = rows[row];
        if (layout || strcmp(previous_.lines[index], text.lines[index])) field(screen, 205, 63 + row * 29, 264, 15, 1, text.lines[index], kCream);
      }
    }
    previous_ = text; page_ = page; painted_ = true;
  }
 private:
  template <class Screen> static void print(Screen& screen, int x, int y, int size, const char* text, uint16_t color) {
    screen.setTextColor(color); screen.setTextSize(size); screen.setCursor(x, y); screen.print(text);
  }
  template <class Screen> static void field(Screen& screen, int x, int y, int width, int height, int size, const char* text, uint16_t color) {
    screen.fillRect(x, y, width, height, kNavy); print(screen, x, y, size, text, color);
  }
  DisplayText previous_;
  FaceRenderer faceRenderer_;
  bool painted_ = false;
  uint8_t page_ = 0;
};
}  // namespace bullseye


// ===== esp32-display/bullseye_display/TouchInput.h =====

#include <stdint.h>
#include <stddef.h>
#include <cstdlib>

namespace onebox {
enum class TouchState : uint8_t { NoFrame, Released, Contact, Cancel, Error };
struct TouchFrame {
  TouchState state;
  int16_t x, y;
  uint8_t id;
};
enum class GestureKind : uint8_t { None, Tap, Left, Right };
struct Gesture {
  GestureKind kind;
  int16_t x, y;
};

// Rotation 3 for the DFRobot IPS panel. Reject, never clamp bad coordinates.
inline bool mapTouch(uint16_t x, uint16_t y, bool focalTech, TouchFrame& out) {
  if (x >= 320 || y >= 480) return false;
  out.x = focalTech ? y : 479 - y;
  out.y = focalTech ? x : 319 - x;
  return true;
}

// Bus contract: exact-length reads and acknowledged writes; bounded by the
// platform adapter. No Arduino dependencies, heap allocation or scan delays.
// Sources and controller identification limits: docs/results/esp32-touch-ui-20261020.md.
template <class Bus>
class TouchController {
 public:
  explicit TouchController(Bus& bus) : bus_(bus) {}
  bool begin() {
    kind_ = 0;
    uint8_t id[4] = {}, size[4] = {};
    if (bus_.read(0x5D, 0x8140, 2, id, 4) && id[0] == '9' && id[1] == '1' && id[2] == '1' &&
        id[3] == 0 && bus_.read(0x5D, 0x8048, 2, size, 4) && (size[0] | (size[1] << 8)) == 320 &&
        (size[2] | (size[3] << 8)) == 480) {
      kind_ = 1;
    } else if (bus_.read(0x38, 0xA3, 1, id, 1) && id[0] == 0x54) {
      kind_ = 2;  // FT5436 family, not an unconditional fallback for failed reads.
    }
    return kind_ != 0;
  }
  const char* name() const { return kind_ == 1 ? "GT911" : kind_ == 2 ? "FT54xx" : "unavailable"; }
  TouchFrame poll() {
    TouchFrame out = {TouchState::Error, 0, 0, 0};
    if (kind_ == 1) {
      uint8_t status = 0, point[8] = {};
      if (!bus_.read(0x5D, 0x814E, 2, &status, 1)) return out;
      if (!(status & 0x80)) {
        out.state = TouchState::NoFrame;
        return out;
      }
      const uint8_t count = status & 15;
      if (count == 1 && !bus_.read(0x5D, 0x814F, 2, point, 8)) return out;
      // Acknowledge only after consuming the coherent ready frame.
      if (!bus_.write(0x5D, 0x814E, 0)) return out;
      out.state = count == 0 ? TouchState::Released : TouchState::Cancel;
      if (count == 1 && !(status & 0x70) && point[0] <= 4 &&
          mapTouch(point[1] | (point[2] << 8), point[3] | (point[4] << 8), false, out)) {
        out.state = TouchState::Contact;
        out.id = point[0];
      } else if (status & 0x70)
        out.state = TouchState::Cancel;
    } else if (kind_ == 2) {
      uint8_t data[7] = {};
      if (!bus_.read(0x38, 0, 1, data, sizeof(data))) return out;
      out.state = data[2] == 0 ? TouchState::Released : TouchState::Cancel;
      const uint8_t event = data[3] >> 6;
      if (data[0] != 0)
        out.state = TouchState::Cancel;
      else if (data[2] == 1 && event <= 2 && (data[5] >> 4) < 15 &&
               mapTouch(((data[3] & 15) << 8) | data[4], ((data[5] & 15) << 8) | data[6], true,
                        out)) {
        out.state = event == 1 ? TouchState::Released : TouchState::Contact;
        out.id = data[5] >> 4;
      }
    }
    return out;
  }

 private:
  Bus& bus_;
  uint8_t kind_ = 0;
};

class TouchGestures {
 public:
  void cancel() {
    active_ = false;
    blocked_ = true;
  }
  Gesture update(TouchFrame frame, uint32_t now) {
    Gesture result = {GestureKind::None, 0, 0};
    if (active_ && now - lastFrame_ > 250) cancel();
    if (frame.state == TouchState::NoFrame) return result;  // Not a finger-up event.
    if (frame.state == TouchState::Error || frame.state == TouchState::Cancel) {
      cancel();
      return result;
    }
    if (frame.state == TouchState::Released) {
      if (active_ && !blocked_) {
        const int dx = lastX_ - startX_, dy = lastY_ - startY_;
        const uint32_t elapsed = now - started_;
        result.x = startX_;
        result.y = startY_;
        if (elapsed <= 1500 && std::abs(dx) >= 70 && maxY_ <= 45 && std::abs(dx) > 2 * std::abs(dy))
          result.kind = dx < 0 ? GestureKind::Left : GestureKind::Right;
        else if (elapsed >= 30 && elapsed <= 600 && maxX_ <= 18 && maxY_ <= 18)
          result.kind = GestureKind::Tap;
      }
      active_ = blocked_ = false;
      return result;
    }
    if (frame.x < 0 || frame.x >= 480 || frame.y < 0 || frame.y >= 320) {
      cancel();
      return result;
    }
    if (blocked_) return result;
    if (!active_) {
      active_ = true;
      started_ = now;
      startX_ = frame.x;
      startY_ = frame.y;
      maxX_ = maxY_ = 0;
      id_ = frame.id;
    }
    if (frame.id != id_) {
      cancel();
      return result;
    }
    lastX_ = frame.x;
    lastY_ = frame.y;
    lastFrame_ = now;
    const int dx = std::abs(lastX_ - startX_), dy = std::abs(lastY_ - startY_);
    if (dx > maxX_) maxX_ = dx;
    if (dy > maxY_) maxY_ = dy;
    return result;
  }

 private:
  bool active_ = false, blocked_ = false;
  int16_t startX_ = 0, startY_ = 0, lastX_ = 0, lastY_ = 0;
  int maxX_ = 0, maxY_ = 0;
  uint8_t id_ = 0;
  uint32_t started_ = 0, lastFrame_ = 0;
};
}  // namespace onebox


// ===== esp32-display/bullseye_display/DisplayInput.h =====



namespace bullseye {
inline void handleGesture(Model& model, const onebox::Gesture& gesture, uint32_t now) {
  if (model.happyActive(now)) return;  // Preserve the local page during the arrival celebration.
  if (gesture.kind == onebox::GestureKind::Left) model.page = (model.page + 1) % kPageCount;
  else if (gesture.kind == onebox::GestureKind::Right) model.page = (model.page + kPageCount - 1) % kPageCount;
  // Navigation is swipe-only. Former tab/button hit regions have no effect.
}
}  // namespace bullseye


// ===== esp32-scooper/bullseye_scooper/ScooperConfig.h =====

// Everything you are expected to edit lives here: pins, limits, trims and poses.
//
// Angles are "logical" degrees, the same for both sticks:
//   90 = stick pointing straight down, lower = swung outward, higher = swung inward.
// The right servo is mounted mirror-image, so `inverted` flips its angles on the way
// out (180 - angle). That makes one pose move both sticks out (or in) together.
#include <stdint.h>

namespace scooper {

constexpr uint8_t kJointCount = 2;

struct Joint {
  const char* name;  // Shown in `status` and parsed by Mission Control.
  uint8_t pin;       // ESP32-S3 GPIO number.
  uint8_t minDeg;    // Soft limits (logical degrees): commands outside are rejected.
  uint8_t maxDeg;
  uint8_t homeDeg;   // Pose at power-up and on `home`: straight down.
  int8_t trimDeg;    // Added at the servo to correct the horn's spline offset.
  bool inverted;     // Mirror-mounted servo.
};

// The squeeze, as described: start straight down, swing out ~30°, then back in
// to ~80° inward of straight down (a 110° swing that ends under the block).
constexpr uint8_t kDownDeg = 90;
constexpr uint8_t kOutDeg = kDownDeg - 30;
constexpr uint8_t kInDeg = kDownDeg + 80;

// SG90 signals: GPIO39 (left) and GPIO40 (right); moved from 41/42 for isolation testing.
// Not 35/36/37 on that header: the board's octal PSRAM uses them. Also avoid 0/45/46
// (boot strapping), 19/20 (USB), 43/44 (debug UART) and 4-13 (display + touch).
// GPIO47/48 use 1.8V logic on the N32R16V module; do not use for these servo signals.
constexpr Joint kJoints[kJointCount] = {
    {"left", 39, kOutDeg - 10, kInDeg + 5, kDownDeg, 0, false},
    {"right", 40, kOutDeg - 10, kInDeg + 5, kDownDeg, 0, true},
};

// SG90: 50 Hz, about 500 us = 0° to 2400 us = 180° (the rover's pan servo uses the same).
constexpr uint16_t kPulseMinUs = 500;
constexpr uint16_t kPulseMaxUs = 2400;
constexpr uint16_t kServoHz = 50;

constexpr uint16_t kDefaultDegPerSec = 90;

// A sequence is a short list of steps. Each step moves both sticks together at
// degPerSec (they start level and travel equally, so they arrive together), then
// waits holdMs. kKeep leaves a joint where it is.
constexpr int16_t kKeep = -1;
struct Step {
  const char* label;
  int16_t deg[kJointCount];
  uint16_t degPerSec;
  uint16_t holdMs;
};

constexpr Step kSqueezeSteps[] = {
    {"down", {kDownDeg, kDownDeg}, 90, 200},
    {"out", {kOutDeg, kOutDeg}, 90, 300},
    {"in", {kInDeg, kInDeg}, 60, 0},  // Slower, so the block is lifted, not knocked.
};
constexpr Step kReleaseSteps[] = {
    {"out", {kOutDeg, kOutDeg}, 90, 300},
    {"down", {kDownDeg, kDownDeg}, 90, 0},
};

}  // namespace scooper


// ===== esp32-scooper/bullseye_scooper/Scooper.h =====

// Scooper motion logic. No Arduino dependency, so it runs in native tests and can
// later drop into the display sketch beside the BLE and touch code. Nonblocking:
// call update() from loop(); every motion is a time-based slew toward a target.
#include <stddef.h>
#include <stdint.h>

namespace scooper {

enum class State : uint8_t {
  Relaxed,   // No PWM pulses: servos are limp. Also the state before begin().
  Holding,   // At target, holding torque.
  Moving,    // Single move (`set` or `home`) in progress.
  Sequence,  // Running squeeze or release steps.
};

inline const char* stateName(State state) {
  switch (state) {
    case State::Relaxed: return "relaxed";
    case State::Holding: return "holding";
    case State::Moving: return "moving";
    case State::Sequence: return "sequence";
  }
  return "?";
}

inline bool inLimits(uint8_t joint, int deg) {
  return deg >= kJoints[joint].minDeg && deg <= kJoints[joint].maxDeg;
}

template <size_t N>
constexpr uint8_t stepCount(const Step (&)[N]) { return static_cast<uint8_t>(N); }

// Out provides attach(joint), write(joint, servoDeg) and detach(joint).
template <class Out>
class Scooper {
 public:
  static constexpr uint32_t kMaxTickMs = 200;  // A stalled loop slows motion, never jumps.

  explicit Scooper(Out& out) : out_(out) {}

  // Checks the tables in ScooperConfig.h. Nothing moves until this passes.
  bool validate() {
    valid_ = false;
    for (uint8_t i = 0; i < kJointCount; ++i) {
      const Joint& j = kJoints[i];
      if (j.minDeg > j.maxDeg || j.maxDeg > 180 || !inLimits(i, j.homeDeg)) {
        return fail("a joint's limits or home angle are invalid");
      }
    }
    if (!stepsValid(kSqueezeSteps, stepCount(kSqueezeSteps)) ||
        !stepsValid(kReleaseSteps, stepCount(kReleaseSteps))) {
      return fail("a squeeze/release step angle is outside its joint's limits");
    }
    valid_ = true;
    return true;
  }

  // Starts pulses at the home pose. Servos jump there at power-up: keep hands clear.
  bool begin(uint32_t now) {
    if (!valid_ && !validate()) return false;
    for (uint8_t i = 0; i < kJointCount; ++i) pos_[i] = target_[i] = kJoints[i].homeDeg;
    attachAll();
    state_ = State::Holding;
    last_ = now;
    return true;
  }

  bool setJoint(uint8_t joint, int deg, uint16_t degPerSec) {
    if (joint >= kJointCount) return fail("no servo with that number");
    if (!inLimits(joint, deg)) return fail("angle is outside that servo's limits");
    if (!ready()) return false;
    target_[joint] = static_cast<float>(deg);
    speed_ = degPerSec;
    state_ = State::Moving;
    return true;
  }

  bool home() {
    if (!ready()) return false;
    for (uint8_t i = 0; i < kJointCount; ++i) target_[i] = kJoints[i].homeDeg;
    speed_ = kDefaultDegPerSec;
    state_ = State::Moving;
    return true;
  }

  bool squeeze() { return run(kSqueezeSteps, stepCount(kSqueezeSteps), "squeeze"); }
  bool release() { return run(kReleaseSteps, stepCount(kReleaseSteps), "release"); }

  // Freeze where the sticks are now and abandon any sequence. Keeps holding torque.
  void stop() {
    for (uint8_t i = 0; i < kJointCount; ++i) target_[i] = pos_[i];
    steps_ = nullptr;
    if (state_ != State::Relaxed) state_ = State::Holding;
  }

  // Stop pulses so the servos go limp and quiet. The next move restarts from the
  // last commanded angles, so a stick pushed by hand meanwhile will snap back.
  void relax() {
    stop();
    for (uint8_t i = 0; i < kJointCount; ++i) out_.detach(i);
    state_ = State::Relaxed;
  }

  void update(uint32_t now) {
    uint32_t dt = now - last_;
    last_ = now;
    if (dt > kMaxTickMs) dt = kMaxTickMs;
    if (state_ != State::Moving && state_ != State::Sequence) return;
    if (!slew(dt)) return;
    if (state_ == State::Moving) {
      state_ = State::Holding;
      return;
    }
    if (!arrived_) {
      arrived_ = true;
      arrivedAt_ = now;
    }
    if (now - arrivedAt_ < steps_[index_].holdMs) return;
    if (++index_ >= count_) {
      steps_ = nullptr;
      state_ = State::Holding;
      return;
    }
    loadStep();
  }

  State state() const { return state_; }
  int angle(uint8_t joint) const { return static_cast<int>(pos_[joint] + 0.5f); }
  int targetAngle(uint8_t joint) const { return static_cast<int>(target_[joint] + 0.5f); }
  const char* sequenceName() const { return steps_ ? sequence_ : ""; }
  const char* stepLabel() const { return steps_ ? steps_[index_].label : ""; }
  uint8_t stepIndex() const { return steps_ ? index_ : 0; }
  const char* error() const { return error_; }

 private:
  bool fail(const char* message) {
    error_ = message;
    return false;
  }

  static bool stepsValid(const Step* steps, uint8_t count) {
    for (uint8_t s = 0; s < count; ++s) {
      for (uint8_t i = 0; i < kJointCount; ++i) {
        const int deg = steps[s].deg[i];
        if (deg != kKeep && !inLimits(i, deg)) return false;
      }
    }
    return true;
  }

  // New commands wait for a running sequence to be stopped; a relaxed arm re-arms.
  bool ready() {
    if (!valid_) return fail("config invalid; fix ScooperConfig.h");
    if (state_ == State::Sequence) return fail("busy with a sequence; send stop first");
    if (state_ == State::Relaxed) attachAll();
    return true;
  }

  bool run(const Step* steps, uint8_t count, const char* name) {
    if (count == 0) return fail("sequence is empty");
    if (!ready()) return false;
    steps_ = steps;
    count_ = count;
    index_ = 0;
    sequence_ = name;
    state_ = State::Sequence;
    loadStep();
    return true;
  }

  void loadStep() {
    const Step& step = steps_[index_];
    for (uint8_t i = 0; i < kJointCount; ++i) {
      if (step.deg[i] != kKeep) target_[i] = step.deg[i];
    }
    speed_ = step.degPerSec;
    arrived_ = false;
  }

  // Moves each joint at most speed * dt toward its target. True once all arrived.
  bool slew(uint32_t dt) {
    const float maxStep = speed_ == 0 ? 180.0f : speed_ * (dt / 1000.0f);
    bool done = true;
    for (uint8_t i = 0; i < kJointCount; ++i) {
      const float diff = target_[i] - pos_[i];
      if (diff == 0) continue;
      if (diff > maxStep) pos_[i] += maxStep;
      else if (diff < -maxStep) pos_[i] -= maxStep;
      else pos_[i] = target_[i];
      out_.write(i, servoDeg(i));
      if (pos_[i] != target_[i]) done = false;
    }
    return done;
  }

  void attachAll() {
    for (uint8_t i = 0; i < kJointCount; ++i) {
      out_.attach(i);
      out_.write(i, servoDeg(i));
    }
  }

  // Logical angle -> servo angle: mirror if inverted, then add the horn trim.
  // The output layer clamps the result to the servo's 0-180 range.
  float servoDeg(uint8_t joint) const {
    const float deg = kJoints[joint].inverted ? 180.0f - pos_[joint] : pos_[joint];
    return deg + kJoints[joint].trimDeg;
  }

  Out& out_;
  State state_ = State::Relaxed;
  bool valid_ = false;
  float pos_[kJointCount] = {};
  float target_[kJointCount] = {};
  uint16_t speed_ = kDefaultDegPerSec;
  uint32_t last_ = 0;
  const Step* steps_ = nullptr;
  uint8_t count_ = 0, index_ = 0;
  const char* sequence_ = "";
  bool arrived_ = false;
  uint32_t arrivedAt_ = 0;
  const char* error_ = "";
};

}  // namespace scooper


// ===== esp32-companion/ServoPwm.h =====

#include <cmath>

namespace companion {
enum class PwmFault : uint8_t { None, Attach, Write, Detach, Argument };
inline const char* pwmFaultName(PwmFault fault) {
  switch (fault) {
    case PwmFault::Attach: return "attach";
    case PwmFault::Write: return "write";
    case PwmFault::Detach: return "detach";
    case PwmFault::Argument: return "invalid argument";
    default: return "none";
  }
}

// Actual HAL return values establish readiness, not an immediate duty/frequency
// readback. LEDC applies a new duty at the next PWM cycle (20 ms at 50 Hz).
// Used by the uploadable sketch and regression checks with delayed-readback HAL.
template<class Hal> class ServoPwm {
 public:
  static constexpr uint8_t kBits = 14;
  explicit ServoPwm(Hal& hal) : hal_(hal) {}
  void attach(uint8_t joint) {
    if (!valid(joint) || !healthy() || on_[joint]) return;
    if (!hal_.attach(scooper::kJoints[joint].pin, scooper::kServoHz, kBits)) { fail(PwmFault::Attach, joint); return; }
    on_[joint] = true; written_[joint] = false;
  }
  void write(uint8_t joint, float degrees) {
    if (!valid(joint) || !healthy()) return;
    if (!on_[joint] || !std::isfinite(degrees)) { fail(PwmFault::Argument, joint); return; }
    if (degrees < 0) degrees = 0;
    if (degrees > 180) degrees = 180;
    const float us = scooper::kPulseMinUs + (scooper::kPulseMaxUs - scooper::kPulseMinUs) * degrees / 180.0f;
    const uint32_t duty = static_cast<uint32_t>(us * (1UL << kBits) * scooper::kServoHz / 1000000.0f + 0.5f);
    if (!hal_.write(scooper::kJoints[joint].pin, duty)) { fail(PwmFault::Write, joint); return; }
    written_[joint] = true;
  }
  void detach(uint8_t joint) {
    if (!valid(joint) || !on_[joint]) return;
    if (!hal_.detach(scooper::kJoints[joint].pin)) { fail(PwmFault::Detach, joint); return; }
    on_[joint] = written_[joint] = false;
    hal_.low(scooper::kJoints[joint].pin);
  }
  bool healthy() const { return fault_ == PwmFault::None; }
  bool initialized() const {
    if (!healthy()) return false;
    for (uint8_t i = 0; i < scooper::kJointCount; ++i) if (!on_[i] || !written_[i]) return false;
    return true;
  }
  PwmFault fault() const { return fault_; }
  uint8_t faultJoint() const { return faultJoint_; }
 private:
  bool valid(uint8_t joint) { if (joint < scooper::kJointCount) return true; fail(PwmFault::Argument, joint); return false; }
  void fail(PwmFault fault, uint8_t joint) {
    if (healthy()) { fault_ = fault; faultJoint_ = joint; hal_.error(pwmFaultName(fault), joint); }
    // Roll back both outputs on an actual HAL error. Reconnect never rearms a
    // failed PWM output; recovery requires reset and fresh initialization.
    for (uint8_t i = 0; i < scooper::kJointCount; ++i) {
      if (!on_[i]) continue;
      hal_.detach(scooper::kJoints[i].pin); hal_.low(scooper::kJoints[i].pin);
      on_[i] = written_[i] = false;
    }
  }
  Hal& hal_;
  PwmFault fault_ = PwmFault::None;
  uint8_t faultJoint_ = 255;
  bool on_[scooper::kJointCount] = {}, written_[scooper::kJointCount] = {};
};
}  // namespace companion


// ===== esp32-companion/ArduinoServoPwm.h =====

#include <Arduino.h>

namespace companion {
class ArduinoServoPwm {
 public:
  bool attach(uint8_t pin, uint32_t hz, uint8_t bits) { return ledcAttach(pin, hz, bits); }
  bool write(uint8_t pin, uint32_t duty) { return ledcWrite(pin, duty); }
  bool detach(uint8_t pin) { return ledcDetach(pin); }
  void low(uint8_t pin) { pinMode(pin, OUTPUT); digitalWrite(pin, LOW); }
  void error(const char* stage, uint8_t joint) {
    if (joint < scooper::kJointCount) Serial.printf("Servo PWM %s failed: %s GPIO%u. Both outputs disabled.\n", stage, scooper::kJoints[joint].name, scooper::kJoints[joint].pin);
    else Serial.printf("Servo PWM %s failed: invalid joint %u. Both outputs disabled.\n", stage, joint);
  }
};
}  // namespace companion


// ===== esp32-companion/CompanionHttp.h =====

#include <stdint.h>
#include <stddef.h>
#include <string.h>
#include <stdio.h>
#include <ctype.h>
#include <limits.h>

namespace companion {
enum class Command : uint8_t { Invalid, Status, Squeeze, Release, Home, Stop, Relax };
inline const char* commandName(Command command) {
  switch (command) {
    case Command::Status: return "status";
    case Command::Squeeze: return "squeeze";
    case Command::Release: return "release";
    case Command::Home: return "home";
    case Command::Stop: return "stop";
    case Command::Relax: return "relax";
    default: return "invalid";
  }
}
inline Command commandFrom(const char* name) {
  for (uint8_t i = 1; i <= 6; ++i) if (!strcmp(name, commandName(static_cast<Command>(i)))) return static_cast<Command>(i);
  return Command::Invalid;
}
inline bool unsigned32(const char* text, uint32_t& value) {
  if (!text || !*text) return false;
  uint32_t result = 0;
  for (const char* c = text; *c; ++c) {
    if (*c < '0' || *c > '9') return false;
    const uint32_t digit = *c - '0';
    if (result > (UINT32_MAX - digit) / 10) return false;
    result = result * 10 + digit;
  }
  value = result; return true;
}
inline bool equalsIgnoreCase(const char* first, const char* second) {
  while (*first && *second) {
    if (tolower(static_cast<unsigned char>(*first++)) != tolower(static_cast<unsigned char>(*second++))) return false;
  }
  return *first == *second;
}

struct Request {
  Command command = Command::Invalid;
  uint32_t boot = 0, sequence = 0;
  int error = 400;
};

// Small fixed-endpoint HTTP/1.x decoder. No body, chunked transfer, keep-alive,
// dynamic allocation, blocking reads or unbounded request processing.
class HttpDecoder {
 public:
  static constexpr size_t capacity = 1536;
  static constexpr uint32_t timeoutMs = 500;
  void reset(uint32_t now) { length_ = 0; ready_ = false; error_ = 0; started_ = now; }
  bool expired(uint32_t now) const { return static_cast<uint32_t>(now - started_) >= timeoutMs; }
  bool ready() const { return ready_; }
  void feed(const uint8_t* data, size_t count) {
    for (size_t i = 0; i < count && !ready_; ++i) {
      const uint8_t c = data[i];
      if ((c < 32 && c != '\r' && c != '\n' && c != '\t') || c > 126) { error_ = 400; ready_ = true; break; }
      if (length_ == capacity - 1) { error_ = 431; ready_ = true; break; }
      text_[length_++] = static_cast<char>(c);
      text_[length_] = '\0';
      if (length_ >= 4 && !memcmp(text_ + length_ - 4, "\r\n\r\n", 4)) ready_ = true;
    }
  }
  Request decode() {
    Request result;
    if (!ready_) return result;
    if (error_) { result.error = error_; return result; }
    char* end = strstr(text_, "\r\n");
    if (!end || end - text_ > 224) return result;
    *end = '\0';
    char method[8], path[192], version[16], extra;
    if (sscanf(text_, "%7s %191s %15s %c", method, path, version, &extra) != 3 ||
        (strcmp(version, "HTTP/1.1") && strcmp(version, "HTTP/1.0"))) return result;
    bool contentLengthSeen = false;
    for (char* header = end + 2; *header;) {
      char* next = strstr(header, "\r\n");
      if (!next) return result;
      if (next == header) break;
      *next = '\0';
      char* colon = strchr(header, ':');
      if (!colon || colon == header || *header == ' ' || *header == '\t') return result;
      *colon = '\0';
      char* value = colon + 1;
      while (*value == ' ' || *value == '\t') ++value;
      char* tail = value + strlen(value);
      while (tail > value && (tail[-1] == ' ' || tail[-1] == '\t')) *--tail = '\0';
      if (equalsIgnoreCase(header, "Transfer-Encoding")) return result;
      if (equalsIgnoreCase(header, "Content-Length")) {
        uint32_t length = 0;
        if (contentLengthSeen || !unsigned32(value, length)) return result;
        contentLengthSeen = true;
        if (length != 0) { result.error = 413; return result; }
      }
      header = next + 2;
    }
    if (!strcmp(path, "/status")) {
      if (strcmp(method, "GET")) { result.error = 405; return result; }
      result.command = Command::Status; result.error = 0; return result;
    }
    constexpr const char* prefix = "/command?";
    if (strncmp(path, prefix, strlen(prefix))) { result.error = 404; return result; }
    if (strcmp(method, "POST")) { result.error = 405; return result; }
    unsigned fields = 0;
    for (char* pair = path + strlen(prefix); pair && *pair;) {
      char* next = strchr(pair, '&'); if (next) *next++ = '\0';
      char* equal = strchr(pair, '='); if (!equal) return result;
      *equal++ = '\0';
      unsigned field;
      if (!strcmp(pair, "name")) { field = 1; result.command = commandFrom(equal); }
      else if (!strcmp(pair, "boot")) { field = 2; if (!unsigned32(equal, result.boot)) return result; }
      else if (!strcmp(pair, "seq")) { field = 4; if (!unsigned32(equal, result.sequence)) return result; }
      else return result;
      if (fields & field) return result;
      fields |= field; pair = next;
    }
    if (result.command == Command::Invalid || result.command == Command::Status) return result;
    if (fields != 7 || !result.boot || !result.sequence) { result.error = 409; return result; }
    result.error = 0; return result;
  }
 private:
  char text_[capacity] = {};
  size_t length_ = 0;
  uint32_t started_ = 0;
  bool ready_ = false;
  int error_ = 0;
};

// A newer STOP invalidates older packets even if a transport delivers them late.
class CommandOrder {
 public:
  explicit CommandOrder(uint32_t boot = 1) : boot_(boot ? boot : 1) {}
  void begin(uint32_t boot) { boot_ = boot ? boot : 1; sequence_ = 0; }
  bool accept(uint32_t boot, uint32_t sequence) {
    if (boot != boot_ || sequence == 0 || sequence <= sequence_) return false;
    sequence_ = sequence; return true;
  }
  void fence() { if (sequence_ < UINT32_MAX) ++sequence_; }
  uint32_t boot() const { return boot_; }
  uint32_t sequence() const { return sequence_; }
 private:
  uint32_t boot_, sequence_ = 0;
};
}  // namespace companion


// ===== esp32-companion/CompanionControl.h =====



namespace companion {
enum class StopReason : uint8_t { None, ContactTimeout, LinkLost };
inline const char* stopReasonName(StopReason reason) {
  return reason == StopReason::ContactTimeout ? "control-heartbeat-timeout" : reason == StopReason::LinkLost ? "BLE-link-loss" : "none";
}
// Shared by the actual sketch and native integration checks. Only this main-loop
// controller changes servo targets; telemetry alone never renews motion control.
template <class Out> class Control {
 public:
  explicit Control(Out& out) : arm_(out) {}
  bool begin(uint32_t now, uint32_t boot) {
    order_.begin(boot); servoReady_ = arm_.begin(now); return servoReady_;
  }
  void outputReady(bool ready) { servoReady_ &= ready; if (!servoReady_) arm_.relax(); }
  const scooper::Scooper<Out>& arm() const { return arm_; }
  const CommandOrder& order() const { return order_; }
  bool servoReady() const { return servoReady_; }
  bool watchdogStopped() const { return watchdogStopped_; }
  StopReason stopReason() const { return stopReason_; }
  uint32_t contactAge(uint32_t now) const { return contactSeen_ ? static_cast<uint32_t>(now - lastContact_) : UINT32_MAX; }
  const char* execute(const Request& request, uint32_t now) {
    if (request.error) return "unsupported request";
    if (request.command == Command::Status) { lastContact_ = now; contactSeen_ = true; return nullptr; }
    if (!order_.accept(request.boot, request.sequence)) return "old command or board restarted; reconnect";
    lastContact_ = now; contactSeen_ = true;
    return run(request.command, now, true);
  }
  const char* local(Command command, uint32_t now) { return run(command, now, false); }
  bool setJoint(uint8_t joint, int degrees, uint16_t speed) {
    if (!servoReady_ || !arm_.setJoint(joint, degrees, speed)) return false;
    order_.fence(); wirelessMotion_ = false; watchdogStopped_ = false; stopReason_ = StopReason::None; return true;
  }
  void connectionLost() {
    if (wirelessMotion_ && moving()) stopWireless(StopReason::LinkLost);
    else wirelessMotion_ = false;
  }
  void tick(uint32_t now, bool link) {
    if (linkWasConnected_ && !link) connectionLost();
    linkWasConnected_ = link;
    if (wirelessMotion_ && moving() && static_cast<uint32_t>(now - lastContact_) >= 2000) stopWireless(StopReason::ContactTimeout);
    arm_.update(now);
    if (!moving()) wirelessMotion_ = false;
  }
 private:
  bool moving() const { return arm_.state() == scooper::State::Moving || arm_.state() == scooper::State::Sequence; }
  void stopWireless(StopReason reason) { arm_.stop(); order_.fence(); wirelessMotion_ = false; watchdogStopped_ = true; stopReason_ = reason; }
  const char* run(Command command, uint32_t now, bool wireless) {
    if (command == Command::Stop || command == Command::Relax) {
      if (command == Command::Stop) arm_.stop(); else arm_.relax();
      wirelessMotion_ = false;
      watchdogStopped_ = false; stopReason_ = StopReason::None;
      if (!wireless) order_.fence();
      return nullptr;
    }
    if (!servoReady_) return "servo PWM initialization failed; inspect pins and restart";
    bool ok = false;
    if (command == Command::Squeeze) ok = arm_.squeeze();
    else if (command == Command::Release) ok = arm_.release();
    else if (command == Command::Home) ok = arm_.home();
    else return "unknown command";
    if (!ok) return arm_.error();
    wirelessMotion_ = wireless; watchdogStopped_ = false; stopReason_ = StopReason::None;
    if (wireless) { lastContact_ = now; contactSeen_ = true; }
    return nullptr;
  }
  scooper::Scooper<Out> arm_;
  CommandOrder order_;
  uint32_t lastContact_ = 0;
  StopReason stopReason_ = StopReason::None;
  bool contactSeen_ = false;
  bool servoReady_ = false, wirelessMotion_ = false, watchdogStopped_ = false, linkWasConnected_ = false;
};
}  // namespace companion


// ===== esp32-companion/CompanionBle.h =====


namespace companion {
constexpr const char* kCommandUuid = "3f7c1003-6f54-4a9c-8b2d-56e39a18c201";
constexpr const char* kStatusUuid = "3f7c1004-6f54-4a9c-8b2d-56e39a18c201";
enum class Result : uint8_t { Status, Applied, Invalid, Old, Refused, Overflow };
inline uint32_t read32(const uint8_t* p) {
  return static_cast<uint32_t>(p[0]) | (static_cast<uint32_t>(p[1]) << 8) |
         (static_cast<uint32_t>(p[2]) << 16) | (static_cast<uint32_t>(p[3]) << 24);
}
inline void write32(uint8_t* p, uint32_t value) { for (uint8_t i = 0; i < 4; ++i) p[i] = static_cast<uint8_t>(value >> (8 * i)); }
struct CommandFrame { uint8_t bytes[12] = {}; uint32_t epoch = 0; };
inline Request decodeCommand(const CommandFrame& frame) {
  const auto* p = frame.bytes;
  if (p[0] != 'B' || p[1] != 'C' || p[2] != 1 || p[3] > 5) return {};
  const Command commands[] = {Command::Status, Command::Squeeze, Command::Release, Command::Home, Command::Stop, Command::Relax};
  const uint32_t boot = read32(p + 4), seq = read32(p + 8);
  if (!boot || (p[3] == 0 ? seq != 0 : seq == 0)) return {};
  return {commands[p[3]], boot, seq, 0};
}
// Called only under the shared state mutex. A fixed-size write fits even MTU 23.
// Callbacks copy bytes; the main loop validates commands and controls the servos.
class CommandMailbox {
 public:
  void reset() { count_ = 0; error_ = Result::Status; }
  void feed(const uint8_t* bytes, size_t count, uint32_t epoch) {
    if (count != 12) { error_ = Result::Invalid; return; }
    if (count_ == 2) {
      if (bytes[0] == 'B' && bytes[1] == 'C' && bytes[2] == 1 && bytes[3] == 4) count_ = 0;
      else { error_ = Result::Overflow; return; }
    }
    memcpy(frames_[count_].bytes, bytes, 12); frames_[count_++].epoch = epoch;
  }
  bool pop(CommandFrame& frame) {
    if (!count_) return false;
    frame = frames_[0]; if (--count_) frames_[0] = frames_[1]; return true;
  }
  Result takeError() { const Result error = error_; error_ = Result::Status; return error; }
 private:
  CommandFrame frames_[2]; uint8_t count_ = 0; Result error_ = Result::Status;
};
template<class Out> Result apply(Control<Out>& control, const CommandFrame& frame, uint32_t now) {
  const Request request = decodeCommand(frame);
  if (request.error) return Result::Invalid;
  if (request.boot != control.order().boot()) return Result::Old;
  if (request.command != Command::Status && request.sequence <= control.order().sequence()) return Result::Old;
  return control.execute(request, now) ? Result::Refused : Result::Applied;
}
template<class Out> void encodeStatus(uint8_t* out, const Control<Out>& control, Result result, uint32_t reply) {
  const auto& arm = control.arm();
  out[0] = 'B'; out[1] = 'C'; out[2] = 1; out[3] = static_cast<uint8_t>(result);
  write32(out + 4, control.order().boot()); write32(out + 8, control.order().sequence()); write32(out + 12, reply);
  out[16] = (control.servoReady() ? 1 : 0) | (control.watchdogStopped() ? 2 : 0) |
            (static_cast<uint8_t>(arm.state()) << 2) | (!strcmp(arm.sequenceName(), "release") ? 16 : 0);
  out[17] = static_cast<uint8_t>(arm.angle(0)); out[18] = static_cast<uint8_t>(arm.angle(1));
  out[19] = arm.state() == scooper::State::Sequence ? arm.stepIndex() + 1 : 0;
}
}  // namespace companion


// ===== esp32-companion/CompanionRuntime.h =====

#include <Arduino.h>
#include <esp_random.h>


namespace companion {
class Runtime {
 public:
  Runtime() : servos_(pwm_), control_(servos_) {}
  CommandMailbox mailbox;
  void begin() {
    bool output = control_.begin(millis(), esp_random());
    output &= servos_.initialized();
    control_.outputReady(output);
    if (!output) Serial.println("Scooper PWM failed; motion disabled until restart.");
    Serial.println("Combined BLE display + scooper ready. Serial: status, pwm, stop, relax, home, squeeze, release, set 1|2 degrees [speed].");
    printStatus();
  }
  void poll(uint32_t now) {
    if (havePoll_) { const uint32_t gap = now - lastPoll_; if (gap > maxLoopGap_) maxLoopGap_ = gap; }
    havePoll_ = true; lastPoll_ = now;
    readSerial(now); updateMotion(millis());
  }
  // Main loop only. Epoch fencing handles a disconnect/reconnect between ticks.
  void link(bool connected, uint32_t epoch, uint32_t now) {
    if (epoch != epoch_) { control_.connectionLost(); epoch_ = epoch; }
    connected_ = connected; updateMotion(now);
  }
  void updateMotion(uint32_t now) {
    control_.outputReady(servos_.healthy());
    if (control_.watchdogStopped() && reportedStop_ != control_.stopReason()) {
      reportedStop_ = control_.stopReason();
      Serial.printf("Scooper stopped: %s control_age_ms=%lu max_loop_gap_ms=%lu\n", stopReasonName(reportedStop_),
        static_cast<unsigned long>(control_.contactAge(now)), static_cast<unsigned long>(maxLoopGap_));
    } else if (!control_.watchdogStopped()) reportedStop_ = StopReason::None;
    control_.tick(now, connected_);
    control_.outputReady(servos_.healthy());
  }
  Result execute(const CommandFrame& frame, uint32_t now) {
    control_.outputReady(servos_.healthy());
    const Result result = apply(control_, frame, now);
    control_.outputReady(servos_.healthy());
    const Command command = decodeCommand(frame).command;
    if (result == Result::Applied && !control_.servoReady() && command != Command::Status && command != Command::Stop) return Result::Refused;
    return result;
  }
  void status(uint8_t* out, Result result = Result::Status, uint32_t reply = 0) const { encodeStatus(out, control_, result, reply); }
 private:
  void printStatus() const {
    const auto& arm = control_.arm();
    Serial.printf("BLE scooper boot=%lu seq=%lu ready=%d state=%s left=%d right=%d watchdog=%d\n",
      static_cast<unsigned long>(control_.order().boot()), static_cast<unsigned long>(control_.order().sequence()),
      control_.servoReady(), scooper::stateName(arm.state()), arm.angle(0), arm.angle(1), control_.watchdogStopped());
    Serial.printf("Diagnostics: stop_reason=%s control_age_ms=%lu max_loop_gap_ms=%lu PWM_fault=%s\n",
      stopReasonName(control_.stopReason()), static_cast<unsigned long>(control_.contactAge(millis())),
      static_cast<unsigned long>(maxLoopGap_), pwmFaultName(servos_.fault()));
  }
  void serialCommand() {
    line_[lineLength_] = '\0';
    char* name = strtok(line_, " \t"); if (!name) return;
    if (!strcmp(name, "status")) { printStatus(); return; }
    if (!strcmp(name, "pwm")) {
      for (uint8_t i = 0; i < scooper::kJointCount; ++i) {
        const uint8_t pin = scooper::kJoints[i].pin;
        Serial.printf("PWM %s GPIO%u: frequency_hz=%lu duty=%lu / 16384\n", scooper::kJoints[i].name, pin,
          static_cast<unsigned long>(ledcReadFreq(pin)), static_cast<unsigned long>(ledcRead(pin)));
      }
      Serial.println("Readback is PWM register state, not measured shaft position. Wait >20 ms after a move before reading.");
      return;
    }
    if (!strcmp(name, "x")) name = const_cast<char*>("stop");
    if (!strcmp(name, "set")) {
      uint32_t joint = 0, degrees = 0, speed = scooper::kDefaultDegPerSec;
      const char* speedText;
      if (!unsigned32(strtok(nullptr, " \t"), joint) || !unsigned32(strtok(nullptr, " \t"), degrees) ||
          ((speedText = strtok(nullptr, " \t")) && !unsigned32(speedText, speed)) || strtok(nullptr, " \t") ||
          joint < 1 || joint > 2 || degrees > 180 || speed < 1 || speed > 600 || !control_.servoReady()) { Serial.println("error: set 1|2 degrees [speed 1-600]"); return; }
      if (!control_.setJoint(joint - 1, static_cast<int>(degrees), speed)) Serial.printf("error: %s\n", control_.arm().error());
      else Serial.println("ok");
      return;
    }
    if (strtok(nullptr, " \t")) { Serial.println("error: unexpected arguments"); return; }
    const char* error = control_.local(commandFrom(name), millis());
    if (error) Serial.printf("error: %s\n", error); else { Serial.println("ok"); printStatus(); }
  }
  void readSerial(uint32_t now) {
    if (lineLength_ && static_cast<uint32_t>(now - lineStarted_) >= 2000) { lineLength_ = 0; lineOverflow_ = true; }
    for (int budget = 128; budget > 0 && Serial.available(); --budget) {
      const char c = static_cast<char>(Serial.read());
      if (c == '\r' || c == '\n') {
        if (lineOverflow_) Serial.println("error: oversized, invalid or expired serial line");
        else if (lineLength_) serialCommand();
        lineLength_ = 0; lineOverflow_ = false;
      } else if (c < 32 || c > 126 || lineLength_ == sizeof(line_) - 1) lineOverflow_ = true;
      else if (!lineOverflow_) { if (!lineLength_) lineStarted_ = now; line_[lineLength_++] = c; }
    }
  }
  ArduinoServoPwm pwm_;
  ServoPwm<ArduinoServoPwm> servos_;
  Control<ServoPwm<ArduinoServoPwm>> control_;
  char line_[64] = {};
  size_t lineLength_ = 0;
  uint32_t lineStarted_ = 0, epoch_ = 0;
  uint32_t lastPoll_ = 0, maxLoopGap_ = 0;
  StopReason reportedStop_ = StopReason::None;
  bool havePoll_ = false;
  bool connected_ = false, lineOverflow_ = false;
};
}  // namespace companion


// ===== Shared Arduino setup and loop =====
// Display/BLE runtime, sharing the loop with the independent scooper controller.
#include <Arduino.h>
#include <SPI.h>
#include <Wire.h>
#include <DFRobot_GDL.h>
#include <BLEDevice.h>
#include <BLEServer.h>
#include <BLE2902.h>
#if defined(CONFIG_NIMBLE_ENABLED)
#include <host/ble_hs_mbuf.h>
#endif



companion::Runtime companionController;

DFRobot_ST7365P_320x480_HW_SPI screen(8, 10, 9, GDL_PIN_NC);
bullseye::Receiver receiver;
bullseye::Model model;
bullseye::Renderer renderer;
SemaphoreHandle_t stateMutex;
BLEServer* server = nullptr;
BLECharacteristic* ackCharacteristic = nullptr;
BLE2902* ackSubscription = nullptr;
bool connected = false, advertisePending = false;
int32_t activeConnection = -1;
uint32_t epoch = 0, disconnectedAt = 0;

// Exact-length, bounded touch access copied from the working Onebox adapter.
class TouchBus {
 public:
  bool read(uint8_t address, uint16_t reg, uint8_t regBytes, uint8_t* out, size_t count) {
    Wire.beginTransmission(address);
    if (regBytes == 2) Wire.write(static_cast<uint8_t>(reg >> 8));
    Wire.write(static_cast<uint8_t>(reg));
    if (Wire.endTransmission(false) != 0) return false;
    if (Wire.requestFrom(address, count, true) != count) {
      while (Wire.available()) Wire.read();
      return false;
    }
    for (size_t i = 0; i < count; ++i) out[i] = static_cast<uint8_t>(Wire.read());
    return true;
  }
  bool write(uint8_t address, uint16_t reg, uint8_t value) {
    Wire.beginTransmission(address);
    Wire.write(static_cast<uint8_t>(reg >> 8));
    Wire.write(static_cast<uint8_t>(reg));
    Wire.write(value);
    return Wire.endTransmission(true) == 0;
  }
};
TouchBus touchBus;
onebox::TouchController<TouchBus> touchController(touchBus);
onebox::TouchGestures gestures;
bool touchBusStarted = false, touchReady = false;
uint32_t lastTouch = 0, lastTouchAttempt = 0, lastRender = 0;

void beginTouch() {
  pinMode(6, OUTPUT); digitalWrite(6, LOW);
  pinMode(7, OUTPUT); digitalWrite(7, LOW);
  delay(10); digitalWrite(6, HIGH); delay(5);
  delay(50); pinMode(7, INPUT); delay(100);
  Wire.setTimeOut(5);
  touchBusStarted = Wire.begin(4, 5, 100000);
  touchReady = touchBusStarted && touchController.begin();
  lastTouchAttempt = millis();
  Serial.printf("Touch: %s\n", touchController.name());
}

// Included by the single-file generator after the display's global declarations.
BLECharacteristic* controlStatusCharacteristic = nullptr;
BLE2902* controlSubscription = nullptr;
uint32_t lastControlStatus = 0;

class ControlCallbacks : public BLECharacteristicCallbacks {
  void ingest(BLECharacteristic* characteristic, uint16_t id) {
    const String data = characteristic->getValue();
    xSemaphoreTake(stateMutex, portMAX_DELAY);
    if (connected && activeConnection == id)
      companionController.mailbox.feed(reinterpret_cast<const uint8_t*>(data.c_str()), data.length(), epoch);
    xSemaphoreGive(stateMutex);
  }
#if defined(CONFIG_NIMBLE_ENABLED)
  void onWrite(BLECharacteristic* characteristic, ble_gap_conn_desc* desc) override { ingest(characteristic, desc->conn_handle); }
#else
  void onWrite(BLECharacteristic* characteristic, esp_ble_gatts_cb_param_t* param) override { ingest(characteristic, param->write.conn_id); }
#endif
};

// Main loop + state mutex held: never acknowledge a command to a later central.
void sendControlStatusLocked(companion::Result result, uint32_t reply) {
  uint8_t bytes[20]; companionController.status(bytes, result, reply);
  controlStatusCharacteristic->setValue(bytes, sizeof(bytes));
  if (!connected || activeConnection < 0) return;
#if defined(CONFIG_NIMBLE_ENABLED)
  os_mbuf* buffer = ble_hs_mbuf_from_flat(bytes, sizeof(bytes));
  if (buffer) ble_gatts_notify_custom(static_cast<uint16_t>(activeConnection), controlStatusCharacteristic->getHandle(), buffer);
#else
  if (!controlSubscription->getNotifications()) return;
  esp_ble_gatts_send_indicate(server->getGattsIf(), static_cast<uint16_t>(activeConnection),
                            controlStatusCharacteristic->getHandle(), sizeof(bytes), bytes, false);
#endif
}

void beginControlGatt(BLEService* service) {
  controlStatusCharacteristic = service->createCharacteristic(companion::kStatusUuid,
      BLECharacteristic::PROPERTY_READ | BLECharacteristic::PROPERTY_NOTIFY);
#if defined(CONFIG_BLUEDROID_ENABLED)
  controlSubscription = new BLE2902(); controlStatusCharacteristic->addDescriptor(controlSubscription);
#endif
  uint8_t bytes[20]; companionController.status(bytes); controlStatusCharacteristic->setValue(bytes, sizeof(bytes));
  auto* command = service->createCharacteristic(companion::kCommandUuid, BLECharacteristic::PROPERTY_WRITE);
  command->setCallbacks(new ControlCallbacks());
}

void pollControlGatt(uint32_t now) {
  xSemaphoreTake(stateMutex, portMAX_DELAY);
  companionController.link(connected, epoch, now);
  const auto error = companionController.mailbox.takeError();
  if (connected && error != companion::Result::Status) sendControlStatusLocked(error, 0);
  for (uint8_t i = 0; i < 2; ++i) {
    companion::CommandFrame frame;
    if (!companionController.mailbox.pop(frame)) break;
    if (connected && frame.epoch == epoch) {
      const auto result = companionController.execute(frame, now);
      sendControlStatusLocked(result, companion::read32(frame.bytes + 8));
    }
  }
  if (connected && static_cast<uint32_t>(now - lastControlStatus) >= 500) {
    lastControlStatus = now; sendControlStatusLocked(companion::Result::Status, 0);
  }
  xSemaphoreGive(stateMutex);
}

class ServerCallbacks : public BLEServerCallbacks {
  void accept(BLEServer* owner, uint16_t id) {
    xSemaphoreTake(stateMutex, portMAX_DELAY);
    const bool reject = connected;
    if (!reject) {
      connected = true; activeConnection = id;
      ++epoch; receiver.reset(); companionController.mailbox.reset(); advertisePending = false;
    }
    xSemaphoreGive(stateMutex);
    if (reject) owner->disconnect(id);
  }
  void dropped(uint16_t id) {
    xSemaphoreTake(stateMutex, portMAX_DELAY);
    if (activeConnection == id) {
      connected = false; activeConnection = -1; ++epoch; receiver.reset(); companionController.mailbox.reset();
      advertisePending = true; disconnectedAt = millis();
    }
    xSemaphoreGive(stateMutex);
  }
#if defined(CONFIG_NIMBLE_ENABLED)
  void onConnect(BLEServer* owner, ble_gap_conn_desc* desc) override { accept(owner, desc->conn_handle); }
  void onDisconnect(BLEServer*, ble_gap_conn_desc* desc) override { dropped(desc->conn_handle); }
#else
  void onConnect(BLEServer* owner, esp_ble_gatts_cb_param_t* param) override { accept(owner, param->connect.conn_id); }
  void onDisconnect(BLEServer*, esp_ble_gatts_cb_param_t* param) override { dropped(param->disconnect.conn_id); }
#endif
};

class DataCallbacks : public BLECharacteristicCallbacks {
  void ingest(BLECharacteristic* characteristic, uint16_t id) {
    // getValue is bounded by the GATT attribute limit, and also works for the
    // core's execute-write callback. No JSON or display access in this callback.
    const String data = characteristic->getValue();
    xSemaphoreTake(stateMutex, portMAX_DELAY);
    if (connected && activeConnection == id) {
      if (data.length() > 512) receiver.reject();
      else receiver.feed(reinterpret_cast<const uint8_t*>(data.c_str()), data.length(), millis(), epoch);
    }
    xSemaphoreGive(stateMutex);
  }
#if defined(CONFIG_NIMBLE_ENABLED)
  void onWrite(BLECharacteristic* characteristic, ble_gap_conn_desc* desc) override { ingest(characteristic, desc->conn_handle); }
#else
  void onWrite(BLECharacteristic* characteristic, esp_ble_gatts_cb_param_t* param) override { ingest(characteristic, param->write.conn_id); }
#endif
};

// State mutex held: bind the notification to the accepted connection, rather
// than broadcasting an old frame's ACK to a newly connected central.
void sendAckLocked(bullseye::Ack status, uint32_t sequence) {
  uint8_t bytes[8]; bullseye::encodeAck(bytes, status, sequence);
  ackCharacteristic->setValue(bytes, sizeof(bytes));
  if (connected && activeConnection >= 0) {
#if defined(CONFIG_NIMBLE_ENABLED)
    os_mbuf* buffer = ble_hs_mbuf_from_flat(bytes, sizeof(bytes));
    if (buffer) ble_gatts_notify_custom(static_cast<uint16_t>(activeConnection), ackCharacteristic->getHandle(), buffer);
#else
    if (!ackSubscription->getNotifications()) return;
    esp_ble_gatts_send_indicate(server->getGattsIf(), static_cast<uint16_t>(activeConnection),
                               ackCharacteristic->getHandle(), sizeof(bytes), bytes, false);
#endif
  }
}

void beginBle() {
  BLEDevice::init("Bullseye-Display");
  BLEDevice::setMTU(185);  // Preference only; sender uses the actual negotiated MTU.
  server = BLEDevice::createServer();
  server->setCallbacks(new ServerCallbacks());
  BLEService* service = server->createService(bullseye::kServiceUuid);
  ackCharacteristic = service->createCharacteristic(bullseye::kAckUuid,
      BLECharacteristic::PROPERTY_READ | BLECharacteristic::PROPERTY_NOTIFY);
#if defined(CONFIG_BLUEDROID_ENABLED)
  ackSubscription = new BLE2902();
  ackCharacteristic->addDescriptor(ackSubscription);
#endif
  uint8_t initial[8]; bullseye::encodeAck(initial, bullseye::Ack::Invalid, 0);
  ackCharacteristic->setValue(initial, sizeof(initial));
  BLECharacteristic* rx = service->createCharacteristic(bullseye::kRxUuid, BLECharacteristic::PROPERTY_WRITE);
  rx->setCallbacks(new DataCallbacks());
  beginControlGatt(service);
  service->start();
  BLEAdvertisementData advertised, response;
  advertised.setFlags(0x06);
  advertised.setCompleteServices(BLEUUID(bullseye::kServiceUuid));
  response.setName("Bullseye-Display");
  BLEAdvertising* advertising = server->getAdvertising();
  advertising->setAdvertisementData(advertised);
  advertising->setScanResponseData(response);
  advertising->setScanResponse(true);
  advertising->start();
  Serial.println("Bullseye BLE display ready; waiting for Mac sender.");
}

void setup() {
  Serial.begin(115200);
  stateMutex = xSemaphoreCreateMutex();
  if (!stateMutex) { Serial.println("Unable to allocate display mailbox mutex"); while (true) delay(1000); }
  SPI.begin(12, 13, 11, 10);
  screen.begin(8000000);
  screen.setRotation(3);
  beginTouch();
  renderer.render(screen, model, touchReady ? touchController.name() : "unavailable", millis());
  companionController.begin();
  beginBle();
}

void loop() {
  companionController.poll(millis());
  uint32_t now = millis();
  bool advertise = false;
  xSemaphoreTake(stateMutex, portMAX_DELAY);
  receiver.expire(now);
  model.link(connected, epoch, now);
  const uint8_t error = receiver.takeError();
  if (error) { ++model.errors; if (connected) sendAckLocked(static_cast<bullseye::Ack>(error), 0); }
  if (advertisePending && !connected && static_cast<uint32_t>(now - disconnectedAt) >= 100) {
    advertise = true; advertisePending = false;
  }
  xSemaphoreGive(stateMutex);
  if (advertise) server->startAdvertising();
  pollControlGatt(millis());

  for (uint8_t i = 0; i < 2; ++i) {
    bullseye::Frame frame;
    xSemaphoreTake(stateMutex, portMAX_DELAY);
    const bool haveFrame = receiver.pop(frame);
    xSemaphoreGive(stateMutex);
    if (!haveFrame) break;
    bullseye::Sample sample;
    const bool valid = bullseye::decodeSample(frame, sample);
    xSemaphoreTake(stateMutex, portMAX_DELAY);
    model.link(connected, epoch, millis());
    if (connected && frame.epoch == epoch) {
      const auto result = valid ? model.apply(sample, frame, millis()) : bullseye::Ack::Invalid;
      if (result != bullseye::Ack::Applied) ++model.errors;
      sendAckLocked(result, valid ? sample.seq : 0);
    }
    xSemaphoreGive(stateMutex);
  }

  now = millis();
  if (touchBusStarted && !touchReady && static_cast<uint32_t>(now - lastTouchAttempt) >= 5000) {
    lastTouchAttempt = now; touchReady = touchController.begin();
  }
  if (touchReady && static_cast<uint32_t>(now - lastTouch) >= 20) {
    lastTouch = now;
    const auto frame = touchController.poll();
    if (frame.state == onebox::TouchState::Error) {
      touchReady = false; lastTouchAttempt = now; gestures.cancel();
    } else {
      const auto gesture = gestures.update(frame, now);
      bullseye::handleGesture(model, gesture, now);
    }
  }
  if (static_cast<uint32_t>(now - lastRender) >= 100) {
    lastRender = now;
    companionController.updateMotion(millis());
    renderer.render(screen, model, touchReady ? touchController.name() : "unavailable", now);
    companionController.updateMotion(millis());
  }
  delay(1);
}
